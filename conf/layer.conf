## conf/layer.conf
```bitbake
# We have a conf and classes directory, append to BBPATH
BBPATH .= ":${LAYERDIR}"

# We have a recipes directory containing .bb and .bbappend files, add to BBFILES
BBFILES += "${LAYERDIR}/recipes*/*/*.bb \
            ${LAYERDIR}/recipes*/*/*.bbappend"

BBFILE_COLLECTIONS += "dhcp-server"
BBFILE_PATTERN_dhcp-server := "^${LAYERDIR}/"
BBFILE_PRIORITY_dhcp-server = "9"

LAYERSERIES_COMPAT_dhcp-server = "dunfell"
```
